;======================================================================================================================================================
;The KP580BI53 is operational up to 2MHz on ALE pin (up to 12MHz CPU)
;22,118MHz CPU, 24MHz CPU - NOT SUPPORT !!!

KP580BI53_A0_PIN bit P2.7
KP580BI53_A1_PIN bit P2.6

USE_KP580BI53_CS set 0
if USE_KP580BI53_CS
KP580BI53_CS_PIN bit P2.0
endif

USE_COMMON_GATE_PIN  set 1
if USE_COMMON_GATE_PIN
KP580BI53_GATE_PIN   bit P1.2
else
KP580BI53_GATE_0_PIN bit P1.2
KP580BI53_GATE_1_PIN bit P1.2
KP580BI53_GATE_2_PIN bit P3.0
endif

CH0 set 0
CH1 set 1
CH2 set 2
CWR set 3 ; Control Word Register, only write
;======================================================================================================================================================
; А1   А0   Counter
; 0    0    0
; 0    1    1
; 1    0    2
; 1    1    CWR (Control Word Register, only write)
;------------------------------------------------------------------------------------------------------------------------------------------------------
;   Control Word Register, only write
;   D7 D6 D5 D4 D3 D2 D1 D0
;   |  |  |  |  |  |  |  |
;   |  |  |  |  |  |  |  +- BCD (0 - binary, 1 - BCD)
;   |  |  |  |  +  +  + --- M - Mode (000 - Mode0, 001 - Mode1, 010 - Mode2, 011 - Mode3, 100 - Mode4, 101 - Mode5)
;   |  |  +  + ------------ RL1,RL0 - Read/Load Byte (00 - Counter Latching operation, 01 - read/write low byte, 10 - read/write high byte, 11 - read/write word (low byte first))
;   +  + ------------------ SC1,SC0 - Select Counter (00 - Select Counter0, 01 - Select Counter1, 10 - Select Counter2, 11 - illegal)

SEL_COUNT_0 set 00000000b ; may be changed to CH0*64=0
SEL_COUNT_1 set 01000000b ; may be changed to CH1*64=64
SEL_COUNT_2 set 10000000b ; may be changed to CH2*64=128

COUNT_LATCH set   000000b ; 1 or 2 bytes must be read, low byte first
RW_LOW      set   010000b
RW_HIGH     set   100000b
RW_WORD     set   110000b ; 2 bytes must be read/write, low byte first

MODE_0      set     0000b
MODE_1      set     0010b
MODE_2      set     0100b
MODE_3      set     0110b
MODE_4      set     1000b
MODE_5      set     1010b

BINARY      set        0b
BCD         set        1b

; user friendly timers definitions
TIMER       set    MODE_0
PWM         set    MODE_1
SERVO       set    MODE_1
MEANDER     set    MODE_3
MUSIC       set    MODE_3
;======================================================================================================================================================
;Все 3 счетчика КР580ВИ53 16-разрядные (2 байта), считают от установленного числа "вниз" до 0, и могут быть настроены для работы в следующих режимах:
;======================================================================================================================================================
;Режим 0 - Выдача сигнала прерывания по окончанию счета
;------------------------------------------------------------------------------------------------------------------------------------------------------
;После установки режима 0 на выходе канала появляется уровень 0.
;После загрузки числа в счетчик канала, выход канала остается в 0 и счетчик считает, пока на входе разрешения канала установлен уровень 1.
;После завершения счета на выходе канала устанавливается уровень 1 и остается до тех пор, пока счетчик канала не будет перезагружен новым числом.

;Этот режим удобно применять для отсчета изменяющихся временных отрезков. Надо поставить инвертор (например 74HC04), и завести через него выход канала на внешнее прерывание (срабатывание по спаду).
;Можно применять для ШИМ-сигналов, но необходимость постоянно переписывать значения счетчика не очень удобна, и для ШИМ гораздо лучше подходит
;======================================================================================================================================================
;Режим 1 - Ждущий мультивибратор с программно устанавливаемой длительностью сигнала
;------------------------------------------------------------------------------------------------------------------------------------------------------
;После установки режима 1 на выходе канала появляется уровень 1.
;После загрузки числа в счетчик канала выход канала устанавливается в 0 после первого тактового сигнала, следующего за переходом 0->1 на входе разрешения канала.
;После завершения счета на выходе канала устанавливается уровень 1.
;Повторный переход 0->1 на входе разрешения канала утанавливает на выходе канала уровень 1, и перезапускает счет.
;Переходы 1->0 на входе разрешения канала не влияют на выход канала и счет.

;Этот режим совместно с любым другим таймером очень удобно применять для управления сервоприводами и ШИМирования светододов (особенно RGB).
;Надо поставить инвертор (например 74HC04), и раз в 20мс (f=50Гц, например по общесистемному программному таймеру таймеру) дергать вход разрешения канала,
;и выход канала будет автоматически включаться на заданное время. Нет необходимости перезагружать счетчик новым значением, достаточно просто дернуть вход, и получить импульс заданной длинны.
;3 доступных канала позволяют 1 микросхемой ШИМить RGB-светодиод, а объединение входов резрешения GATE позволяет запускать все 3 канала 1 импульсом.
;Если нет возможности сделать общесистемный программный таймер, можно использовать один из каналов КР580ВИ53 в режиме 0, но в таком случае количество свободных ШИМ-каналов КР580ВИ53 упадет до 2.
;Если использовать запись только старшего байта, то типичные значения:
;От 1 до 153 = 1-99% PWM. Для получения 0% PWM не трогать вход разрешения канала. Для получения 100% PWM записать в старший байт 0. 1000us = 8 единиц старшего байта (1 попугай = 120-125 мкс)
;SERVO_MIN_POSITION    set 5
;SERVO_MEDIUM_POSITION set 12
;SERVO_MAX_POSITION    set 20
;Всего 15 положений на 180гр. Дискретность 12гр на 1 положение. Если надо точнее - использовать также младший байт
;======================================================================================================================================================
;Режим 2 - генератор тактовых сигналов
;------------------------------------------------------------------------------------------------------------------------------------------------------
;В режиме 2 на выходе канала через число периодов тактовой частоты, записанное в счетчике канала, появляется уровень 0 длительностью в один период тактовой частоты.
;======================================================================================================================================================
;Режим 3 - генератор прямоугольных сигналов
;------------------------------------------------------------------------------------------------------------------------------------------------------
;В режиме 3 на выходе канала будет уровень 1 в течение первой половины интервала времени, определяемого числом в счетчике, и уровень 0 в течение второй половины.

;Этот режим очень удобно применять для звукосинтезации.
;Счетчик канала 0 интервального таймера является генератором тона.
;Высота самого низкого тона определяется коэффициентом деления: при максимальном его значении 2^16 и тактовой частоте 2 МГц (pin ALE 8051) он равен примерно 32Гц.
;Канал 2 использован в качестве генератора импульса строба, определяющего продолжительность звучания тона.
;Длительность этого импульса зависит от коэффициента пересчета счетчика канала 2 и периода повторения сигнала на его входе.
;Период же повторения, в свою очередь, целиком определяется коэффициентом деления счетчика канала 1.
;Таким образом, каналы 0 и 1 работают в режиме программируемого деления частоты. Скважность выходного сигнала этих каналов принципиального значения не имеет,
;однако, по ряду соображений, целесообразно выбрать скважность, равную двум (меандр). Такая форма сигнала получается при работе счетчика таймера в режиме 3.
;Если необходимый коэффициент деления четное число, скважность сигнала на выходе точно равна двум,
;а если нечетное, то высокий уровень на выходе будет присутствовать в течение (N+1)/2 периодов входного сигнала, а низкий - в течение (N-1)/2 периодов.
;Формировать сигнал строба (канал 2) можно несколькими способами. Наиболее просто это сделать, инициировав счетчик канала 2 в режиме 0 (он носит название режима генерации задержанного сигнала прерывания,
;но мы будем называть его режимом генерации строба в соответствии с функцией, выполняемой этим счетчиком в звукосинтезаторе). В этом случае счетчик работает следующим образом. В исходном состоянии уровень сигнала на выходе счетчика высокий. Сразу же после инициализации по программе режима 0 па выходе появляется низкий уровень. После загрузки числа N (коэффициента пересчета) начинается счет входных импульсов. При поступлении на вход счетчика N импульсов на выходе вновь устанавливается низкий уровень и остается таким до тех пор, пока не будет установлен иной режим работы или вновь загружен коэффициент пересчета.
;Узел совпадения в звукосинтезаторе может быть выполнен на двухвходовом элементе "ИЛИ".
;Итак, применительно к структурной схеме звукосинтезатора из всего многообразия режимов работы таймера выбраны всего два:
;режим 0 (в нашем случае генератор импульса строба) для канала 2
;и режим 3 (генератор меандра) для каналов 0 и 1. При этом все счетчики работают в двоичном коде.

;High byte for 2 МГц on ALE pin 8051:
;Note     Value   Freqency
        ; 1     ; 8kHz
        ; 2     ; 4kHz
        ; 3     ; 2,7kHz
        ; 4     ; 2kHz
        ; 5     ; 1,6kHz
        ; 6     ; 1,3kHz
        ; 7     ; 1,1kHz
si2   set 8     ; 1kHz
la2   set 9     ; 0,9kHz
sol2  set 10    ; 0,8kHz
fa2   set 11    ; 0,73kHz
mi2   set 12    ; 0,67kHz
re2_  set 13    ; 0,62kHz
re2   set 14    ; 0,58kHz
do2_  set 15    ; 0,54kHz
do2   set 16    ; 0,5kHz

si1_  set 17    ; 0,48kHz
si1   set 18    ; 0,45kHz
la1_  set 19    ; 0,42kHz
la1   set 20    ; 0,4kHz
sol1_ set 21    ; 0,38kHz
sol1  set 22    ; 0,36kHz
fa1_  set 23    ; 0,34kHz
fa1   set 24    ; 0,33kHz
mi1_  set 25    ; 0,32kHz
mi1   set 26    ; 0,31kHz
re1_  set 27    ; 0,3kHz
re1   set 28    ; 0,29kHz
do1_  set 29    ; 0,28kHz
do1   set 30    ; 0,27kHz

;Первая октава
; do1   , 262 Гц
; do1_  , 277 Гц
; re1   , 294 Гц
; re1_  , 311 Гц
; mi1   , 330 Гц
; fa1   , 349 Гц
; fa1_  , 370 Гц
; sol1  , 392 Гц
; sol1_ , 415 Гц
; la1   , 440 Гц
; la1_  , 466 Гц
; si1,  , 494 Гц
;Вторая октава
; do2   , 523 Гц
; do2_  , 554 Гц
; re2   , 588 Гц
; re2_  , 622 Гц
; mi2   , 660 Гц
; fa2   , 698 Гц
; fa2_  , 740 Гц
; sol2  , 784 Гц
; sol2_ , 831 Гц
; la2   , 880 Гц
; la2_  , 932 Гц
; si2,  , 988 Гц
;======================================================================================================================================================-
;Режим 4 - программно-управляемый строб
;------------------------------------------------------------------------------------------------------------------------------------------------------
;После установки режима 4 на выходе канала появляется уровень 1. 
;После загрузки числа в счетчик канала, выход остается в 1 и счетчик считает, пока на входе разрешения канала установлен уровень 1,
;После завершения счета на выходе канала появляется импульс уровня 0 длительностью в один период тактовой частоты.
;======================================================================================================================================================
;Режим 5 - схемотехнически управляемый строб
;------------------------------------------------------------------------------------------------------------------------------------------------------
;Работа канала в режиме 5 аналогична работе в режиме 4 с той лишь разницей, что счетчик канала после загрузки начинает счет только по переходу 0->1 на входе разрешения канала.
;Повторный переход 0->1 на входе разрешения канала перезапускает счет.
;======================================================================================================================================================
_KP580BI53_READ_BYTE macro dest
                     if dest = CH0
                         clr  KP580BI53_A0_PIN
                         clr  KP580BI53_A1_PIN
                     elseif dest = CH1
                         setb KP580BI53_A0_PIN
                         clr  KP580BI53_A1_PIN
                     elseif dest = CH2
                         clr  KP580BI53_A0_PIN
                         setb KP580BI53_A1_PIN
                     else
                         #error
                     endif
                     call Read_KP580BI53
                     endm
;------------------------------------------------------------------------------------------------------------------------------------------------------
_KP580BI53_WRITE_BYTE macro dest,byte
                      if dest = CH0
                          clr  KP580BI53_A0_PIN
                          clr  KP580BI53_A1_PIN
                      elseif dest = CH1
                          setb KP580BI53_A0_PIN
                          clr  KP580BI53_A1_PIN
                      elseif dest = CH2
                          clr  KP580BI53_A0_PIN
                          setb KP580BI53_A1_PIN
                      elseif dest = CWR
                          setb KP580BI53_A0_PIN
                          setb KP580BI53_A1_PIN
                      else
                          #error
                      endif
                      mov  A,byte
                      call Write_KP580BI53
                      endm
;------------------------------------------------------------------------------------------------------------------------------------------------------
_KP580BI53_WRITE_BYTE_FROM_ACC macro dest
                      if dest = CH0
                          clr  KP580BI53_A0_PIN
                          clr  KP580BI53_A1_PIN
                      elseif dest = CH1
                          setb KP580BI53_A0_PIN
                          clr  KP580BI53_A1_PIN
                      elseif dest = CH2
                          clr  KP580BI53_A0_PIN
                          setb KP580BI53_A1_PIN
                      elseif dest = CWR
                          setb KP580BI53_A0_PIN
                          setb KP580BI53_A1_PIN
                      else
                          #error
                      endif
                      call Write_KP580BI53
                      endm
;------------------------------------------------------------------------------------------------------------------------------------------------------
_KP580BI53_SET_TIMER macro CHANNEL,RW,MODE,BIN_BCD
                     _KP580BI53_write_byte   CWR,#CHANNEL*64+RW+MODE+BIN_BCD
                     endm
;------------------------------------------------------------------------------------------------------------------------------------------------------
_KP580BI53_STROB macro STROB_PIN
                 setb STROB_PIN
                 nop
                 clr  STROB_PIN
                 endm
;======================================================================================================================================================
